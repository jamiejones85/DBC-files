VERSION ""

NS_ :

BS_:
BU_:
BO_ 1313 CURRENT: 6 Vector__XXX
   SG_ Current : 16|32@1- (1,0) [0|0] "mA" Vector__XXX

BO_ 1317 TEMPERATURE: 6 Vector__XXX
   SG_ Temperature : 16|32@1- (0.1,0) [0|0] "C" Vector__XXX

BO_ 1318 WATTS: 6 Vector__XXX
   SG_ Watts : 16|32@1- (1,0) [0|0] "W" Vector__XXX

BO_ 1319 AMPSECONDS: 6 Vector__XXX
   SG_ AmpSeconds : 16|32@1- (1,0) [0|0] "As" Vector__XXX

BO_ 1320 WATTHOURS: 6 Vector__XXX
   SG_ WattHours : 16|32@1- (1,0) [0|0] "Wh" Vector__XXX

BO_ 1314 VOLTAGE1: 6 Vector__XXX
   SG_ Voltage1 : 16|32@1- (1,0) [0|0] "" Vector__XXX

BO_ 1315 VOLTAGE2: 6 Vector__XXX
   SG_ Voltage2 : 16|32@1- (1,0) [0|0] "mV" Vector__XXX

BO_ 1316 VOLTAGE3: 6 Vector__XXX
   SG_ Voltage3 : 16|32@1- (1,0) [0|0] "mV" Vector__XXX

BA_DEF_ BO_ "GenMsgBackgroundColor" STRING ;
BA_DEF_ BO_ "GenMsgForegroundColor" STRING ;
BA_DEF_DEF_ "GenMsgBackgroundColor" "#ffffff";
BA_DEF_DEF_ "GenMsgForegroundColor" "#000000";
