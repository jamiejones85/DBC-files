VERSION ""

NS_ :

BS_:
BU_: HV_Battery_HybridCan
BO_ 151 BMS_Monitoring: 0 HV_Battery_HybridCan
   SG_ BMS_EMRG_COOLING : 63|1@1+ (1,0) [0|0] "" Vector__XXX
   SG_ BMS_STATUS_VOLTAGE_APPLIED : 61|2@1+ (1,0) [0|0] "" Vector__XXX
   SG_ BMS_STATUS_SERVICEDISCONNECT : 60|1@1+ (1,0) [0|0] "" Vector__XXX
   SG_ BMS_ERROR_FUSE : 59|1@1+ (1,0) [0|0] "" Vector__XXX
   SG_ BMS_ERROR_PILOT : 58|1@1+ (1,0) [0|0] "" Vector__XXX
   SG_ BMS_ERROR_COLD_START_POWER : 57|1@1+ (1,0) [0|0] "" Vector__XXX
   SG_ BMS_ERROR_ISOLATION : 56|1@1+ (1,0) [0|0] "" Vector__XXX
   SG_ BMS_ERROR_POWERREDUCTION : 55|1@1+ (1,0) [0|0] "" Vector__XXX
   SG_ BMS_ERROR_CONTACTOR_OPEN : 54|1@1+ (1,0) [0|0] "" Vector__XXX
   SG_ BMS_ERROR_CONTACTOR_WELD : 53|1@1+ (1,0) [0|0] "" Vector__XXX
   SG_ BMS_ERROR_HV_SHUTDOWN : 52|1@1+ (1,0) [0|0] "" Vector__XXX
   SG_ BMS_ERROR_HV_SHUTDOWN_REQ : 51|1@1+ (1,0) [0|0] "" Vector__XXX
   SG_ BMS_EMRG_SHUTDOWN_PILOT : 50|1@1+ (1,0) [0|0] "" Vector__XXX
   SG_ BMS_EMRG_SHUTDOWN_CRASH : 49|1@1+ (1,0) [0|0] "" Vector__XXX
   SG_ BMS_INIT_COMPLETE : 41|1@1+ (1,0) [0|0] "" Vector__XXX
   SG_ BMS_ISOLATION_MEASURE_ACTIVE : 40|1@1+ (1,0) [0|0] "" Vector__XXX
   SG_ BMS_SLEEP_INDICATOR : 39|1@1+ (1,0) [0|0] "" Vector__XXX
   SG_ BMS_STATUS : 36|3@1+ (1,0) [0|0] "" Vector__XXX
   SG_ BMS_VOLTAGE : 24|12@1+ (1,0) [0|0] "" Vector__XXX
   SG_ BMS_CURRENT : 12|12@1+ (1,0) [0|0] "" Vector__XXX

BA_DEF_ BO_ "GenMsgBackgroundColor" STRING ;
BA_DEF_ BO_ "GenMsgForegroundColor" STRING ;
BA_DEF_DEF_ "GenMsgBackgroundColor" "#ffffff";
BA_DEF_DEF_ "GenMsgForegroundColor" "#000000";
CM_ BU_ HV_Battery_HybridCan "Messages coming out from nodes within the HV battery on the Hybrid Can";
