VERSION ""

NS_ :

BS_:
BU_:
BO_ 371 BMW_Module_4_P6: 8 Vector__XXX
   SG_ Cell_16 : 1|14@1+ (1,1000) [0|0] "" Vector__XXX

BO_ 129 BMW_Module_1_P1: 8 Vector__XXX
   SG_ Cell_1_Voltage : 0|14@1+ (1,0) [0|0] "mV" Vector__XXX

BO_ 130 BMW_Module_1_P2: 8 Vector__XXX
   SG_ Cell_4_voltage : 0|14@1+ (1,0) [0|0] "mV" Vector__XXX

BO_ 131 BMW_Module_1_P3: 8 Vector__XXX

BA_DEF_ BO_ "GenMsgBackgroundColor" STRING ;
BA_DEF_ BO_ "GenMsgForegroundColor" STRING ;
BA_DEF_DEF_ "GenMsgBackgroundColor" "#ffffff";
BA_DEF_DEF_ "GenMsgForegroundColor" "#000000";
